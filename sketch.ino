#include <Wire.h>
#include <Adafruit_GFX.h>
#include <Adafruit_SSD1306.h>
#include <DHT11.h>
#include <WiFi.h>

#define SCREEN_WIDTH 128
#define SCREEN_HEIGHT 64
#define OLED_RESET -1
#define SCREEN_ADDRESS 0x3C

#define BUZZER 5
#define LED_1 2
#define LED_2 15
#define PB_CANCEL 34
#define PB_OK 32
#define PB_UP 33
#define PB_DOWN 35
#define DHTPIN 4

#define NTP_SERVER     "pool.ntp.org"
// #define UTC_OFFSET     19800
#define UTC_OFFSET_DST 0

// Declare Objects
Adafruit_SSD1306 display(SCREEN_WIDTH, SCREEN_HEIGHT, &Wire, OLED_RESET);
DHT11 dhtSensor(4);

// global variables
int UTC_OFFSET = 19800;
int days = 0;
int hours = 0;
int minutes = 0;
int seconds = 0;

unsigned long timeNow = 0;
unsigned long timeLast = 0;

bool alarm_enabled = false;
int n_alarms = 3;
int alarm_hours[] = {0, 0, 0};
int alarm_minutes[] = {0, 0, 0};
bool alarm_triggered[] = {false, false, false};

int n_notes = 8;
int C = 262;
int D = 294;
int E = 330;
int F = 349;
int G = 392;
int A = 440;
int B = 494;
int C_H = 523;
int notes[] = {C, D, E, F, G, A, B, C_H};

int current_mode = 0;
int max_modes = 5;
String modes[] = {"1 - Set Time", "2 - Set Alarm 1", "3 - Set Alarm 2", "4 - Set Alarm 3", "5 - Disable Alarm"};

int temperature = 0;
int humidity = 0;

const unsigned char high_temp[] PROGMEM = {
    // 'Screenshot 2024-03-02 121602, 128x63px
    0xff, 0xff, 0xff, 0xff, 0xff, 0xff, 0xff, 0xff, 0xff, 0xff, 0xff, 0xff, 0xff, 0xff, 0xff, 0xff,
    0xff, 0xff, 0xff, 0xff, 0xff, 0xff, 0xff, 0xff, 0xff, 0xff, 0xff, 0xff, 0xff, 0xff, 0xff, 0xff,
    0xff, 0xff, 0xff, 0xff, 0xff, 0xff, 0xff, 0xff, 0xff, 0xff, 0xff, 0xff, 0xff, 0xff, 0xff, 0xff,
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    0xff, 0xff, 0xff, 0xff, 0xff, 0xff, 0xff, 0xff, 0xff, 0xff, 0xff, 0xff, 0xff, 0xff, 0xff, 0xff
};

const unsigned char low_temp[] PROGMEM = {
    // 'Screenshot 2024-03-02 121941, 128x64px
    0xff, 0xff, 0xff, 0xff, 0xff, 0xff, 0xff, 0xff, 0xff, 0xff, 0xff, 0xff, 0xff, 0xff, 0xff, 0xff,
    0xff, 0xff, 0xff, 0xff, 0xff, 0xff, 0xff, 0xff, 0xff, 0xff, 0xff, 0xff, 0xff, 0xff, 0xff, 0xff,
    0xff, 0xff, 0xff, 0xff, 0xff, 0xff, 0xff, 0xff, 0xff, 0xff, 0xff, 0xff, 0xff, 0xff, 0xff, 0xff,
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    0xff, 0xff, 0xff, 0xff, 0xff, 0xff, 0xff, 0xff, 0xff, 0xff, 0xff, 0xff, 0xff, 0xff, 0xff, 0xff
};

const unsigned char high_humidity[] PROGMEM = {
    // 'Screenshot 2024-03-02 122144, 128x64px
    0xff, 0xff, 0xff, 0xff, 0xff, 0xff, 0xff, 0xff, 0xff, 0xff, 0xff, 0xff, 0xff, 0xff, 0xff, 0xff,
    0xff, 0xff, 0xff, 0xff, 0xff, 0xff, 0xff, 0xff, 0xff, 0xff, 0xff, 0xff, 0xff, 0xff, 0xff, 0xff,
    0xff, 0xff, 0xff, 0xff, 0xff, 0xff, 0xff, 0xff, 0xff, 0xff, 0xff, 0xff, 0xff, 0xff, 0xff, 0xff,
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    0xff, 0xff, 0xff, 0xff, 0xff, 0xff, 0xff, 0xff, 0xff, 0xff, 0xff, 0xff, 0xff, 0xff, 0xff, 0xff
};

const unsigned char low_humidity[] PROGMEM = {
    // 'Screenshot 2024-03-02 124412, 128x64px
    0xff, 0xff, 0xff, 0xff, 0xff, 0xff, 0xff, 0xff, 0xff, 0xff, 0xff, 0xff, 0xff, 0xff, 0xff, 0xff,
    0xff, 0xff, 0xff, 0xff, 0xff, 0xff, 0xff, 0xff, 0xff, 0xff, 0xff, 0xff, 0xff, 0xff, 0xff, 0xff,
    0xff, 0xff, 0xff, 0xff, 0xff, 0xff, 0xff, 0xff, 0xff, 0xff, 0xff, 0xff, 0xff, 0xff, 0xff, 0xff,
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    0xff, 0xff, 0xff, 0xff, 0xff, 0xff, 0xff, 0xff, 0xff, 0xff, 0xff, 0xff, 0xff, 0xff, 0xff, 0xff
};

const unsigned char medicine_time[] PROGMEM = {
    // 'Screenshot 2024-03-02 122506, 128x64px
    0xff, 0xff, 0xff, 0xff, 0xff, 0xff, 0xff, 0xff, 0xff, 0xff, 0xff, 0xff, 0xff, 0xff, 0xff, 0xff,
    0xff, 0xff, 0xff, 0xff, 0xff, 0xff, 0xff, 0xff, 0xff, 0xff, 0xff, 0xff, 0xff, 0xff, 0xff, 0xff,
    0xff, 0xff, 0xff, 0xff, 0xff, 0xff, 0xff, 0xff, 0xff, 0xff, 0xff, 0xff, 0xff, 0xff, 0xff, 0xff,
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    0xff, 0xff, 0xff, 0xff, 0xff, 0xff, 0xff, 0xff, 0xff, 0xff, 0xff, 0xff, 0xff, 0xff, 0xff, 0xff
};

const unsigned char connect_1[] PROGMEM = {
    // 'Screenshot 2024-03-02 123821, 128x64px
    0xff, 0xff, 0xff, 0xff, 0xff, 0xff, 0xff, 0xff, 0xff, 0xff, 0xff, 0xff, 0xff, 0xff, 0xff, 0xff,
    0xff, 0xff, 0xff, 0xff, 0xff, 0xff, 0xff, 0xff, 0xff, 0xff, 0xff, 0xff, 0xff, 0xff, 0xff, 0xff,
    0xff, 0xff, 0xff, 0xff, 0xff, 0xff, 0xff, 0xff, 0xff, 0xff, 0xff, 0xff, 0xff, 0xff, 0xff, 0xff,
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    0xff, 0xff, 0xff, 0xff, 0xff, 0xff, 0xff, 0xff, 0xff, 0xff, 0xff, 0xff, 0xff, 0xff, 0xff, 0xff
};

const unsigned char connect_2[] PROGMEM = {
    // 'Screenshot 2024-03-02 123957, 128x64px
    0xff, 0xff, 0xff, 0xff, 0xff, 0xff, 0xff, 0xff, 0xff, 0xff, 0xff, 0xff, 0xff, 0xff, 0xff, 0xff,
    0xff, 0xff, 0xff, 0xff, 0xff, 0xff, 0xff, 0xff, 0xff, 0xff, 0xff, 0xff, 0xff, 0xff, 0xff, 0xff,
    0xff, 0xff, 0xff, 0xff, 0xff, 0xff, 0xff, 0xff, 0xff, 0xff, 0xff, 0xff, 0xff, 0xff, 0xff, 0xff,
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    0xff, 0xff, 0xff, 0xff, 0xff, 0xff, 0xff, 0xff, 0xff, 0xff, 0xff, 0xff, 0xff, 0xff, 0xff, 0xff
};

const unsigned char connect_3[] PROGMEM = {
    // 'Screenshot 2024-03-02 124104, 128x64px
    0xff, 0xff, 0xff, 0xff, 0xff, 0xff, 0xff, 0xff, 0xff, 0xff, 0xff, 0xff, 0xff, 0xff, 0xff, 0xff,
    0xff, 0xff, 0xff, 0xff, 0xff, 0xff, 0xff, 0xff, 0xff, 0xff, 0xff, 0xff, 0xff, 0xff, 0xff, 0xff,
    0xff, 0xff, 0xff, 0xff, 0xff, 0xff, 0xff, 0xff, 0xff, 0xff, 0xff, 0xff, 0xff, 0xff, 0xff, 0xff,
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    0xff, 0xff, 0xff, 0xff, 0xff, 0xff, 0xff, 0xff, 0xff, 0xff, 0xff, 0xff, 0xff, 0xff, 0xff, 0xff
};

const unsigned char welcome[] PROGMEM = {
    // 'Screenshot 2024-03-02 125210, 128x63px
    0xff, 0xff, 0xff, 0xff, 0xff, 0xff, 0xff, 0xff, 0xff, 0xff, 0xff, 0xff, 0xff, 0xff, 0xff, 0xff,
    0xff, 0xff, 0xff, 0xff, 0xff, 0xff, 0xff, 0xff, 0xff, 0xff, 0xff, 0xff, 0xff, 0xff, 0xff, 0xff,
    0xff, 0xff, 0xff, 0xff, 0xff, 0xff, 0xff, 0xff, 0xff, 0xff, 0xff, 0xff, 0xff, 0xff, 0xff, 0xff,
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    0xff, 0xff, 0xff, 0xff, 0xff, 0xff, 0xff, 0xff, 0xff, 0xff, 0xff, 0xff, 0xff, 0xff, 0xff, 0xff
};

void set_display(String text, int column, int row, int text_size, bool isDisplay){
    display.setTextSize(text_size);
    display.setTextColor(SSD1306_WHITE);
    display.setCursor(column, row);
    display.println(text);

    if (isDisplay){
      display.display();
    }
}

void print_time_now(void){
  display.clearDisplay();
  set_display("~Smart MediBox~", 15, 0, 1, false);
  set_display("Alarm : " + String(alarm_enabled ? "ON" : "OFF"), 0, 35, 1, false);
  set_display(String(hours) + ":" + String(minutes) + ":" + String(seconds), 20, 15, 2, false);
  set_display("Temperature : "+ String(temperature), 0, 45, 1, false);
  set_display("Humidity : "+ String(humidity), 0, 55, 1, true);
}

void update_time(){
  struct tm timeinfo;
  getLocalTime(&timeinfo);
  
  char timeHour[3];
  strftime(timeHour, 3, "%H", &timeinfo);
  hours = atoi(timeHour);

  char timeMinute[3];
  strftime(timeMinute, 3, "%M", &timeinfo);
  minutes = atoi(timeMinute);

  char timeSecond[3];
  strftime(timeSecond, 3, "%S", &timeinfo);
  seconds = atoi(timeSecond);

  char timeDay[3];
  strftime(timeDay, 3, "%d", &timeinfo);
  days = atoi(timeDay);
}

void ring_alarm(){
  display.clearDisplay();
  display.drawBitmap(0, 0, medicine_time, 128, 64, WHITE);
  display.display();
  digitalWrite(LED_1, HIGH);

  bool break_happened = false;

  while(break_happened == false && digitalRead(PB_CANCEL) == HIGH){
    for (int i = 0; i < n_notes; i++){
      if(digitalRead(PB_CANCEL) == LOW){
        delay(200);
        break_happened = true;
        break;
      }
      tone(BUZZER, notes[0]);
      delay(400);
      noTone(BUZZER);
      delay(400);
    }
  }
  digitalWrite(LED_1, LOW);
  display.clearDisplay();
}

void update_time_with_check_alarm(void){
  update_time();
  print_time_now();

  if ( alarm_enabled == true ){
    for (int i = 0; i < n_alarms; i++){
      if ( alarm_triggered[i] == false && alarm_hours[i] == hours && alarm_minutes[i] == minutes ){
        ring_alarm();
        alarm_triggered[i] = true;
      }
    }
  }
}

int wait_for_button_press(){
  while(true){
    if (digitalRead(PB_UP) == LOW){
      button_blink();
      delay(200);
      return PB_UP;
    }
    if (digitalRead(PB_DOWN) == LOW){
      button_blink();
      delay(200);
      return PB_DOWN;
    }
    if (digitalRead(PB_OK) == LOW){
      button_blink();
      delay(200);
      return PB_OK;
    }
    if (digitalRead(PB_CANCEL) == LOW){
      button_blink();
      delay(200);
      return PB_CANCEL;
    }
    update_time();
  }
}

void print_modes(int mode){
  display.clearDisplay();
  set_display("->", 0, mode * 10, 1, false);
  set_display(modes[0], 15, 0, 1, false);
  set_display(modes[1], 15, 10, 1, false);
  set_display(modes[2], 15, 20, 1, false);
  set_display(modes[3], 15, 30, 1, false);
  set_display(modes[4], 15, 40, 1, true);
}

void go_to_menu(){
  current_mode = 0;
  while (digitalRead(PB_CANCEL) == HIGH){
    print_modes(current_mode);

    int pressed = wait_for_button_press();

    if (pressed == PB_UP){
      delay(200);
      current_mode += 1;
      print_modes(current_mode);
      current_mode = current_mode % max_modes;
    }
    else if (pressed == PB_DOWN){
      delay(200);
      current_mode -= 1;
      print_modes(current_mode);
      if (current_mode < 0){
        current_mode = max_modes - 1;
      }
    }
    else if (pressed == PB_OK){
      delay(200);
      Serial.println(current_mode);
      run_mode(current_mode);
    }
    else if (pressed == PB_CANCEL){
      delay(200);
      break;
    }
  }
}

void run_mode(int mode){
  if (mode == 0){
    set_time();
  }
  if (mode == 1 || mode == 2 || mode == 3){
    set_alarm(mode - 1);
  }
  if (mode == 4){
    alarm_enabled = false;
    display.clearDisplay();
    set_display("Disabled all Alarms !", 0, 0, 1, true);
    delay(500);
  }
}

void set_time(){
  int temp_hour = hours;
  int temp_minutes = minutes;
  int hour_minute = 0;

  while(true){
    display.clearDisplay();
    if(hour_minute == 0){
      set_display("Set Time - hours", 20, 0, 1, false);
      set_display("->", 0, 20, 2, false);
      set_display(String(temp_hour), 30, 20, 2, false);
      set_display(":", 55, 20, 2, false);
      set_display(String(temp_minutes), 70, 20, 2, true);
    }else{
      set_display("Set Time - minutes", 10, 0, 1, false);
      set_display(String(temp_hour), 30, 20, 2, false);
      set_display(":", 55, 20, 2, false);
      set_display(String(temp_minutes), 70, 20, 2, false);
      set_display("<-", 95, 20, 2, true);
    }
    int pressed = wait_for_button_press();

    if (pressed == PB_UP){
      delay(200);
      if(hour_minute == 0){
        temp_hour += 1;
        temp_hour = temp_hour % 24;
      }else{
        temp_minutes += 1;
        temp_minutes = temp_minutes % 60;
      }
    }
    else if (pressed == PB_DOWN){
      delay(200);
      if(hour_minute == 0){
        temp_hour -= 1;
        if (temp_hour < 0){
          temp_hour = 23;
        }
      }else{
        temp_minutes -= 1;
        if (temp_minutes < 0){
          temp_minutes = 59;
        }
      }
    }
    else if (pressed == PB_OK){
      delay(200);
      if(hour_minute == 0){
        UTC_OFFSET += (temp_hour - hours) * 3600;
        hour_minute ++;
      }else{
        UTC_OFFSET += (temp_minutes - minutes) * 60;
        break;
      }
    }
    else if (pressed == PB_CANCEL){
      delay(200);
      display.clearDisplay();
      set_display("Canceled !", 40, 30, 1, true);
      delay(500);
      return;
    }
  }
  Serial.println("UTC OFFSET is " + String(UTC_OFFSET));
  configTime(UTC_OFFSET, UTC_OFFSET_DST, NTP_SERVER);
  display.clearDisplay();
  set_display("Time is set", 20, 30, 1, true);
  delay(500);
}

void set_alarm(int alarm){
  int temp_hour = alarm_hours[alarm];
  int temp_minutes = alarm_minutes[alarm];
  int hour_minute = 0;

  while(true){
    display.clearDisplay();
    set_display("Set Alarm : " + String(alarm + 1), 25, 0, 1, false);
    if(hour_minute == 0){
      set_display("->", 0, 20, 2, false);
      set_display(String(temp_hour), 30, 20, 2, false);
      set_display(":", 55, 20, 2, false);
      set_display(String(temp_minutes), 70, 20, 2, true);
    }else{
      set_display(String(temp_hour), 30, 20, 2, false);
      set_display(":", 55, 20, 2, false);
      set_display(String(temp_minutes), 70, 20, 2, false);
      set_display("<-", 95, 20, 2, true);
    }
    
    int pressed = wait_for_button_press();

    if (pressed == PB_UP){
      delay(200);
      if(hour_minute == 0){
        temp_hour += 1;
        temp_hour = temp_hour % 24;
      }else{
        temp_minutes += 1;
        temp_minutes = temp_minutes % 60;
      }
    }
    else if (pressed == PB_DOWN){
      delay(200);
      if(hour_minute == 0){
        temp_hour -= 1;
        if (temp_hour < 0){
          temp_hour = 23;
        }
      }else{
        temp_minutes -= 1;
        if (temp_minutes < 0){
          temp_minutes = 59;
        }
      }
    }

    else if (pressed == PB_OK){
      delay(200);
      if(hour_minute == 0){
        alarm_hours[alarm] = temp_hour;
        hour_minute ++;
      }else{
        alarm_minutes[alarm] = temp_minutes;
        alarm_enabled = true;
        break;
      }
    }
    else if (pressed == PB_CANCEL){
      delay(200);
      display.clearDisplay();
      set_display("Canceled !", 40, 30, 1, true);
      delay(500);
      return;
    }
  }
  
  display.clearDisplay();
  set_display("Alarm is set", 25, 30, 1, true);
  delay(500);
}

void check_temp(){
  int result = dhtSensor.readTemperatureHumidity(temperature, humidity);

  if (result == 0) {
    Serial.println("Temperature: " + String(temperature));
    Serial.println("Humidity: " + String(humidity) + "% \n");

    if ( temperature > 35 ){
      display.clearDisplay();
      display.drawBitmap(0, 0, high_temp, 128, 64, WHITE);
      display.display();
      warning(2, true);
    }

    else if ( temperature < 22 ){
      display.clearDisplay();
      display.drawBitmap(0, 0, low_temp, 128, 64, WHITE);
      display.display();
      warning(2, true);
    }

    if ( humidity > 90 ){
      display.clearDisplay();
      display.drawBitmap(0, 0, high_humidity, 128, 64, WHITE);
      display.display();
      warning(2, true);
    }

    else if ( humidity < 20 ){
      display.clearDisplay();
      display.drawBitmap(0, 0, low_humidity, 128, 64, WHITE);
      display.display();
      warning(2, true);
    }
  } else {
    Serial.println(DHT11::getErrorString(result));
  }
}

void boot_blink(){
  for(int i = 0; i < 100; i ++){
    if (i % 2 == 0){
      digitalWrite(LED_1, HIGH);
      digitalWrite(LED_2, LOW);
    }else{
      digitalWrite(LED_1, LOW);
      digitalWrite(LED_2, HIGH);
    }
    delay(i);
  }
  digitalWrite(LED_1, LOW);
  digitalWrite(LED_2, HIGH);
}

void warning(int led, bool warning){ // in here warning means temperature or humidity warning
  if(warning){
    if(led == 1){
      digitalWrite(LED_1, HIGH);
      play_buzzer();
      digitalWrite(LED_1, LOW);
    }else{
        digitalWrite(LED_2, HIGH);
        play_buzzer();
        digitalWrite(LED_2, LOW);
    }
  }else{
    if(led == 1){
      for(int i = 0; i < 10; i ++){
        digitalWrite(LED_1, HIGH);
        delay(100);
        digitalWrite(LED_1, LOW);
      }
    }else{
      for(int i = 0; i < 10; i ++){
        digitalWrite(LED_2, HIGH);
        delay(100);
        digitalWrite(LED_2, LOW);
      }
    }
  }
}

void play_buzzer(){
  tone(BUZZER, notes[0]);
  delay(500);
  noTone(BUZZER);
  delay(500);
}

void button_blink(){
  digitalWrite(LED_1, HIGH);
  delay(15);
  digitalWrite(LED_1, LOW);
}

void setup(){
  pinMode(BUZZER, OUTPUT);
  pinMode(LED_1, OUTPUT);
  pinMode(PB_CANCEL, INPUT);
  pinMode(PB_OK, INPUT);
  pinMode(PB_UP, INPUT);
  pinMode(PB_DOWN, INPUT);
  pinMode(LED_2, OUTPUT);

  Serial.begin(9600);

  boot_blink();
  play_buzzer();
  if (!display.begin(SSD1306_SWITCHCAPVCC, SCREEN_ADDRESS))
  {
      Serial.println(F("SSD1306 allocation failed"));
      while(true);
  }

  // show the display buffer on the screen. You MUST call display() after drawing commands to make them visible on the display
  display.display();
  delay(500);

  WiFi.begin("Wokwi-GUEST", "", 6);
  while (WiFi.status() != WL_CONNECTED) {
    display.clearDisplay();
    display.drawBitmap(0, 0, connect_1, 128, 64, WHITE);
    display.display();
    delay(1000);
    display.clearDisplay();
    display.drawBitmap(0, 0, connect_2, 128, 64, WHITE);
    display.display();
    delay(1000);
    display.clearDisplay();
    display.drawBitmap(0, 0, connect_3, 128, 64, WHITE);
    display.display();
    delay(1000);
  }

  display.clearDisplay();
  set_display("Connected to WiFi", 10, 25, 1, true);

  configTime(UTC_OFFSET, UTC_OFFSET_DST, NTP_SERVER);

  display.clearDisplay();
  display.drawBitmap(0, 0, welcome, 128, 64, WHITE);
  display.display();
  delay(2000);
  display.clearDisplay();
}

void loop(){
  update_time_with_check_alarm();
  if (digitalRead(PB_OK) == LOW){
    button_blink();
    delay(200);
    go_to_menu();
  }
  check_temp();
}